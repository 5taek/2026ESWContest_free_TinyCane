## ESP32(객체인식)/sdkconfig.defaults
```kconfig
CONFIG_MBEDTLS_CERTIFICATE_BUNDLE=y
CONFIG_MBEDTLS_CERTIFICATE_BUNDLE_DEFAULT_FULL=y
CONFIG_MBEDTLS_CERTIFICATE_BUNDLE_CROSS_SIGNED_VERIFY=y
CONFIG_MBEDTLS_DYNAMIC_BUFFER=y
CONFIG_MBEDTLS_EXTERNAL_MEM_ALLOC=y
CONFIG_PARTITION_TABLE_CUSTOM=y
CONFIG_PARTITION_TABLE_CUSTOM_FILENAME="partitions.csv"
CONFIG_ESPTOOLPY_FLASHSIZE_8MB=y
CONFIG_ESPTOOLPY_FLASHSIZE="8MB"
CONFIG_ESPTOOLPY_FLASHMODE_QIO=y
CONFIG_SPIRAM=y
CONFIG_SPIRAM_MODE_OCT=y
CONFIG_SPIRAM_SPEED_80M=y
CONFIG_SPIRAM_BOOT_INIT=y
CONFIG_SPIRAM_USE_MALLOC=y
CONFIG_SPIRAM_MALLOC_ALWAYSINTERNAL=16384
CONFIG_SPIRAM_MALLOC_RESERVE_INTERNAL=32768
```

## ESP32(낙상감지&KWS)/main/Kconfig.projbuild
```kconfig
menu "Fall detection Firebase connection"
config FALL_WIFI_SSID
    string "Wi-Fi SSID"
    default ""
config FALL_WIFI_PASSWORD
    string "Wi-Fi password"
    default ""
config FALL_FIREBASE_FUNCTION_URL
    string "reportFall Cloud Function URL"
    default ""
config FALL_FIREBASE_DEVICE_ID
    string "Registered device ID"
    default "cane-001"
config FALL_FIREBASE_DEVICE_TOKEN
    string "Device authentication token"
    default ""
endmenu
```
